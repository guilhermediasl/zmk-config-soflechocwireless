## config/boards/shields/sofle_dongle/Kconfig.defconfig
```kconfig
if SHIELD_SOFLE_DONGLE

config ZMK_KEYBOARD_NAME
    default "SOFLE"

config ZMK_SPLIT_ROLE_CENTRAL
    default y

endif

if SHIELD_SOFLE_LEFT || SHIELD_SOFLE_RIGHT || SHIELD_SOFLE_DONGLE

config ZMK_SPLIT
    default y

config ZMK_BLE
    default y

config ZMK_EXT_POWER
    default y

if ZMK_DISPLAY

config I2C
    default y

config SSD1306
    default y

if SHIELD_SOFLE_DONGLE_XIAO || SHIELD_SOFLE_DONGLE_PRO_MICRO

choice ZMK_DISPLAY_WORK_QUEUE
    default ZMK_DISPLAY_WORK_QUEUE_DEDICATED
endchoice

endif
endif

endif
```

## config/west.yml
```yaml
manifest:
  remotes:
    - name: zmkfirmware
      url-base: https://github.com/zmkfirmware
    - name: mctechnology17
      url-base: https://github.com/mctechnology17
  projects:
    - name: zmk
      remote: zmkfirmware
      revision: e34793e8c7193bc868b95ec38d78f67956f759cb
      import: app/west.yml
    - name: zmk-nice-oled
      remote: mctechnology17
      revision: 5d7dce25735277dd6dcd8295c64e143d4f95cdfa
  self:
    path: config
```
